## bsp/loongarch/ls2k1000/Kconfig
```kconfig
mainmenu "RT-Thread Project Configuration"

BSP_DIR := .

RTT_DIR := ../../..

PKGS_DIR := packages

config RT_CPUS_NR
    default 2 if RT_USING_SMP
    range 1 2 if RT_USING_SMP

source "$(RTT_DIR)/Kconfig"
osource "$PKGS_DIR/Kconfig"

config SOC_LS2K1000LA
    bool
    select ARCH_LOONGARCH64
    select RT_USING_COMPONENTS_INIT
    select RT_USING_USER_MAIN
    select RT_USING_CACHE
    select ARCH_LOONGARCH_FPU
    select ARCH_MM_MMU if RT_USING_SMART
    select ARCH_REMAP_KERNEL if RT_USING_SMART
    default y

config __STACKSIZE__
    int "stack size for interrupt"
    default 16384

if RT_USING_SERIAL
config RT_USING_UART0
    bool "Using RT_USING_UART0"
    default y

config RT_USING_UART4
    bool "Using RT_USING_UART4"
    default y
endif

source "$(RTT_DIR)/bsp/loongarch/common/gmac/Kconfig"

config BSP_USING_SELFTEST
    bool "Build kernel port regression and stress commands"
    default n

config BSP_USING_XINGYUN_LCD
    bool "Xingyun U-Boot 1024x600 RGB framebuffer handoff"
    depends on RT_USING_SMART
    default n
    help
        Validate and reuse the firmware DVO1 mode and reserved framebuffer.
        The driver does not change the panel clocks or pin routing.

source "$(RTT_DIR)/../../display/novauiOS/platform/rtos/Kconfig"

config BSP_USING_XINGYUN_TOUCH
    bool "Xingyun physical I2C1 Goodix touch (polling)"
    depends on BSP_USING_XINGYUN_LCD
    select RT_USING_I2C
    select RT_USING_TOUCH
    default n

menuconfig BSP_USING_USB_HOST
    bool "Xingyun EHCI high-speed USB host (root port 1)"
    default n
    depends on !RT_USING_CHERRYUSB
    select RT_USING_MUTEX
    select RT_USING_SEMAPHORE
    select RT_USING_MESSAGEQUEUE
    select RT_USING_TIMER_SOFT
    select RT_USING_DFS
    select RT_USING_DFS_ELMFAT
    help
        Reuse the board-owned EHCI HCD and unchanged CherryUSB core/hub/MSC.
        Firmware supplies the PCI BAR, PHY and VBUS. Only root port 1 is
        exposed; other root ports, OHCI and OTG are not supported here.

config BSP_USING_USB_CAMERA
    bool "OpenLANPU UVC camera on Xingyun EHCI port 1"
    depends on BSP_USING_USB_HOST && RT_USING_SMART && RT_USING_DFS_V2
    depends on RT_USING_DFS_DEVFS && RT_USING_POSIX_DEVIO && RT_USING_POSIX_POLL
    depends on RT_TICK_PER_SECOND >= 1000
    default n
    help
        Project-owned UVC MJPEG/YUYV capture through /dev/video0.
        Uses permanent uncached DMA storage and copied frame queues.
```

## bsp/loongarch/ls2k3000/Kconfig
```kconfig
# Copyright (C) 2020-2026 Loongson Technology Corporation Limited
#
# SPDX-License-Identifier: Apache-2.0
#
# Change Logs:
# Date           Author                    Notes
# 2026-10-28     LoongsonLab               align file header with LS2K0300

# Description:
#   Configure UEFI boot and board-owned LS2K3000 drivers.

mainmenu "RT-Thread LS2K3000 Explorer Configuration"
BSP_DIR := .
RTT_DIR := ../../..
PKGS_DIR := packages

# Put this board default before the generic SDIO definition: Kconfig uses the
# first matching default. Smart DFS partition registration needs about 6.5 KiB.
config RT_MMCSD_STACK_SIZE
    default 16384 if BSP_USING_LS2K3000_MMC && RT_USING_SMART

# Keep packet storage and core mailboxes large enough for bounded RX bursts.
config RT_LWIP_PBUF_NUM
    default 64 if BSP_USING_LS2K3000_GMAC

config RT_LWIP_TCPTHREAD_MBOX_SIZE
    default 32 if BSP_USING_LS2K3000_GMAC

config RT_LWIP_ETHTHREAD_MBOX_SIZE
    default 32 if BSP_USING_LS2K3000_GMAC

source "$(RTT_DIR)/Kconfig"
osource "$PKGS_DIR/Kconfig"

config BSP_LS2K3000
    bool
    default y
    select ARCH_LOONGARCH64
    select ARCH_LOONGARCH_FPU
    select RT_USING_COMPONENTS_INIT
    select RT_USING_USER_MAIN
    select RT_USING_CACHE
    select ARCH_MM_MMU if RT_USING_SMART
    select ARCH_REMAP_KERNEL if RT_USING_SMART

config RT_CPUS_NR
    range 1 8 if RT_USING_SMP
    default 1 if RT_USING_SMP

config __STACKSIZE__
    int "Boot and per-CPU stack bytes"
    default 16384

config BSP_UART_CLOCK_HZ
    int "UART0 input clock (Hz)"
    default 100000000
    range 1000000 500000000

config BSP_USING_UEFI_FRAMEBUFFER
    bool "Retain firmware GOP scanout"
    default y
    help
        Register an existing linear 32-bit RGB/BGR framebuffer as lcd.
        HDMI mode setting remains owned by firmware before handoff.
        BLT-only modes and unsupported pixel formats are rejected.

config BSP_USING_BOOT_SCREEN
    bool "Show kernel startup status and display checks"
    depends on BSP_USING_UEFI_FRAMEBUFFER && !BSP_USING_NOVAUI
    default y
    help
        Render startup status, resolution, color bars and the full screen border
        into the firmware framebuffer. Keeps the current HDMI/display mode.

config BSP_USING_PCI_INVENTORY
    bool "Inspect firmware PCI resources"
    default y

config BSP_USING_DMA_POOL
    bool

config BSP_USING_USB_MOUSE
    bool "Native xHCI USB mouse"
    select BSP_USING_DMA_POOL
    select BSP_USING_PCI_INVENTORY
    select RT_USING_TOUCH
    select RT_USING_MUTEX
    default n
    help
        Board-owned polled xHCI support for a directly connected USB2 HID mouse.
        Register mouse as an absolute pointer for NovaUIOS, with left-button
        click and drag. Firmware supplies controller resources and port power.
        Hub routing and USB3 devices are not supported by this initial driver.

config BSP_USING_NVME
    bool "NVMe SSD (one namespace, polled queues)"
    select BSP_USING_DMA_POOL
    select BSP_USING_PCI_INVENTORY
    select RT_USING_MUTEX
    select RT_USING_DEVICE_OPS
    default n
    help
        Uses firmware PCI resources and dedicated coherent DMA storage.
        Supports 512-byte and 4 KiB sectors with bounded synchronous commands.
        Does not format or automatically mount any disk. MSI is not required.

config BSP_NVME_ALLOW_WRITE
    bool "Allow explicit NVMe block writes"
    depends on BSP_USING_NVME
    default n


config BSP_USING_LS2K3000_MMC
    bool "Native SD/eMMC memory host"
    select RT_USING_SDIO
    select BSP_USING_DMA_POOL
    select BSP_USING_PCI_INVENTORY
    select RT_USING_MUTEX
    select RT_USING_SEMAPHORE
    default n
    help
        Board-owned synchronous DMA driver for the native LS2K3000 controller.
        Supports SD memory (1/4-bit) and eMMC user area (1/4/8-bit) in SDR mode.
        Does not advertise HS200, HS400, DDR, SDIO function IRQs or hot removal.
        Firmware supplies pad mux, card power and clocks. No automatic mounting.

if BSP_USING_LS2K3000_MMC

config BSP_LS2K3000_MMC_INPUT_HZ
    int "Verified SD/eMMC controller input clock (Hz; 0 disables initialization)"
    range 0 409200000
    default 0
    help
        Must match the firmware clock feeding the native prescaler. Do not use
        the CPU or UART clock. Zero deliberately prevents guessing a frequency.

config BSP_LS2K3000_MMC_MAX_HZ
    int "Maximum SDR card clock (Hz)"
    range 400000 25000000
    default 25000000

config BSP_LS2K3000_MMC_ALLOW_WRITE
    bool "Allow SD/eMMC user-area block writes"
    default n
    help
        Disabled for initial bring-up. The installed eMMC contains Linux and
        its EFI partition. Enabling this does not format or mount any partition.

config BSP_LS2K3000_MMC_ACPI_STATIC
    bool "Use explicit ACPI resources when firmware hides the PCI functions"
    default n
    help
        Use only with resource addresses verified from this board's ACPI _CRS.
        PCI enumeration takes precedence when the native functions are visible.
        Current Explorer firmware exposed eMMC at 0x79990000 and SD at 0x79991000
        in Linux /proc/iomem. Addresses default to zero to avoid stale mappings.

config BSP_LS2K3000_EMMC_BASE
    hex "Verified ACPI eMMC MMIO base (0 skips)"
    depends on BSP_LS2K3000_MMC_ACPI_STATIC
    default 0

config BSP_LS2K3000_SD_BASE
    hex "Verified ACPI SD MMIO base (0 skips)"
    depends on BSP_LS2K3000_MMC_ACPI_STATIC
    default 0

endif

config BSP_USING_LS2K3000_GMAC
    bool "Native GMAC2 Ethernet (polled DMA)"
    depends on RT_USING_LWIP
    select BSP_USING_DMA_POOL
    select BSP_USING_PCI_INVENTORY
    select RT_USING_MUTEX
    select RT_USING_DEVICE_OPS
    default n

config BSP_LS2K3000_MDIO_CLOCK
    int "GMAC MDC divider encoding (verify CSR input clock)"
    depends on BSP_USING_LS2K3000_GMAC
    range 0 5
    default 4
    help
        Encoding 4 divides the CSR clock by 102 (150-250 MHz range).
        Verify the actual CSR clock before hardware validation.

config BSP_GMAC_UDP_QUEUE_SIZE
    int "Bounded UDP receive mailbox entries"
    depends on BSP_USING_LS2K3000_GMAC
    range 16 256
    default 64
    help
        Reuse the LoongArch GMAC lwIP wrapper to retain receive bursts until
        the socket thread can drain them. The common lwIP port stays unchanged.

menu "LS2K3000 low-speed peripherals"

config BSP_USING_LS2K3000_PERIPHERALS
    bool
    select BSP_USING_PCI_INVENTORY
    select RT_USING_MUTEX
    select RT_USING_DEVICE_OPS

config BSP_USING_LS2K3000_I2C
    bool "Native I2C masters (polled)"
    select BSP_USING_LS2K3000_PERIPHERALS
    select RT_USING_I2C
    default n
    help
        Register selected i2c0..i2c3 buses, with 7-bit addressing and repeated
        START. Firmware must configure pad mux and clocks. No automatic scan,
        SPD writes, 10-bit addressing, GPIO bus recovery or slave support.

config BSP_LS2K3000_I2C_MASK
    hex "I2C controller mask (bits 0..3)"
    depends on BSP_USING_LS2K3000_I2C
    range 0x1 0xf
    default 0x3

config BSP_USING_LS2K3000_SPI
    bool "Native SPI masters (polled, thread context)"
    select BSP_USING_LS2K3000_PERIPHERALS
    select RT_USING_SPI
    default n
    help
        Register spi0/spi1 and four native chip-select devices per bus.
        Supports 8-bit MSB-first modes 0..3. Restores firmware flash-read
        registers after CS release or failure. No automatic flash probing,
        erase, write-enable, partition or filesystem registration.
        Boot SPI0 must never be accessed while executing code from flash.

config BSP_LS2K3000_SPI_MASK
    hex "SPI controller mask (bits 0..1)"
    depends on BSP_USING_LS2K3000_SPI
    range 0x1 0x3
    default 0x3

config BSP_LS2K3000_SPI_INPUT_HZ
    int "Verified SPI input clock (Hz)"
    depends on BSP_USING_LS2K3000_SPI
    range 1000000 500000000
    default 100000000

config BSP_USING_LS2K3000_RTC
    bool "Battery-backed TOY RTC (UTC)"
    select BSP_USING_LS2K3000_PERIPHERALS
    select RT_USING_RTC
    default n
    help
        Firmware must enable ACPI register access and the TOY oscillator.
        Registration preserves battery time. Supports dates 1970..9999,
        seconds and 100 ms timeval resolution. No alarm or wakeup IRQ.
        Disable RT_USING_SOFT_RTC before enabling this hardware RTC.

config BSP_USING_LS2K3000_HPET
    bool "Read-only HPET hardware counter"
    select BSP_USING_LS2K3000_PERIPHERALS
    default n
    help
        Register hpet0 if the 64-bit HPET capability is valid. Reads require
        firmware to have enabled the counter. No register writes, comparator
        alarms or IRQ callbacks; the CPU timer still owns the system tick.

config BSP_USING_LS2K3000_GPIO
    bool "Byte-addressed GPIO input/output"
    select BSP_USING_LS2K3000_PERIPHERALS
    select RT_USING_PIN
    default n
    help
        Supports GPIO 0..39 and 46..63. Firmware owns pad mux and pulls.
        No IRQ, debounce or open-drain support. Set the output latch before
        selecting output mode when a glitch-free initial level is needed.

config BSP_USING_LS2K3000_PWM
    bool "Four native 48 MHz PWM channels"
    select BSP_USING_LS2K3000_PERIPHERALS
    select RT_USING_PWM
    default n
    help
        Register pwm0, channels 0..3. No automatic output enable or pin mux.
        Supports period/pulse configuration and explicit enable/disable.
        Rejects 0/100 percent duty, capture, IRQ and complementary modes.

config BSP_USING_LS2K3000_WDT
    bool "Native watchdog (explicit start only)"
    select BSP_USING_LS2K3000_PERIPHERALS
    select RT_USING_WDT
    default n
    help
        Firmware must enable ACPI register access. Register wdt0 without
        starting, stopping or feeding a firmware watchdog. Supports 1..85
        seconds, feed, start and stop; no remaining-time readback exists.

endmenu

osource "$NOVAUI_RTOS_DIR/Kconfig"
```

## bsp/loongarch/ls2kdev/Kconfig
```kconfig
mainmenu "RT-Thread Project Configuration"

BSP_DIR := .

RTT_DIR := ../../..

PKGS_DIR := packages

source "$(RTT_DIR)/Kconfig"
osource "$PKGS_DIR/Kconfig"

config SOC_LS2K1000LA
    bool
    select ARCH_LOONGARCH64
    select RT_USING_COMPONENTS_INIT
    select RT_USING_USER_MAIN
    select RT_USING_CACHE
    select ARCH_LOONGARCH_FPU
    default y

config __STACKSIZE__
    int "stack size for interrupt"
    default 16384

if RT_USING_SERIAL
config RT_USING_UART0
    bool "Using RT_USING_UART0"
    default y

config RT_USING_UART4
    bool "Using RT_USING_UART4"
    default y
endif

source "$(RTT_DIR)/libcpu/loongarch/ls2k/gmac/Kconfig"
```

## bsp/qemu-virt64-loongarch/Kconfig
```kconfig
mainmenu "RT-Thread Project Configuration"

BSP_DIR := .

RTT_DIR := ../../

PKGS_DIR := packages

config RT_CPUS_NR
    default 4 if RT_USING_SMP
    range 1 16 if RT_USING_SMP

source "$(RTT_DIR)/Kconfig"
osource "$PKGS_DIR/Kconfig"
rsource "driver/Kconfig"

config BOARD_QEMU_VIRT_LOONGARCH64
    bool
    select ARCH_LOONGARCH64
    select LOONGARCH_HAS_HARDWARE_PTW
    select RT_USING_COMPONENTS_INIT
    select RT_USING_USER_MAIN
    select RT_USING_CACHE
    select ARCH_MM_MMU if RT_USING_SMART
    select ARCH_REMAP_KERNEL if RT_USING_SMART
    default y

# LP64D context switching requires scalar floating-point registers.
config ENABLE_FPU
    bool
    select ARCH_LOONGARCH_FPU
    default y

config __STACKSIZE__
    int "stack size for interrupt"
    default 4096

config BSP_USING_SELFTEST
    bool "Build kernel port regression tests"
    default n
```

## bsp/qemu-virt64-loongarch/driver/Kconfig
```kconfig
menu "LoongArch QEMU virt64 configs"

config BSP_USING_VIRTIO
    bool "Using VirtIO"
    default n
    depends on RT_USING_DEVICE_OPS && !RT_USING_NANO

config BSP_USING_VIRTIO_BLK
    bool "Using VirtIO BLK"
    default y
    select RT_USING_LEGACY_VIRTIO
    select RT_USING_VIRTIO_BLK
    default n
    depends on BSP_USING_VIRTIO

config BSP_USING_VIRTIO_NET
    bool "Using VirtIO NET"
    select RT_USING_LEGACY_VIRTIO
    select RT_USING_VIRTIO_NET
    default n
    depends on BSP_USING_VIRTIO

config BSP_USING_VIRTIO_CONSOLE
    bool "Using VirtIO Console"
    select RT_USING_LEGACY_VIRTIO
    select RT_USING_VIRTIO_CONSOLE
    default n
    depends on BSP_USING_VIRTIO

config BSP_USING_VIRTIO_GPU
    bool "Using VirtIO GPU"
    select RT_USING_LEGACY_VIRTIO
    select RT_USING_VIRTIO_GPU
    default n
    depends on BSP_USING_VIRTIO

config BSP_USING_VIRTIO_INPUT
    bool "Using VirtIO Input"
    select RT_USING_LEGACY_VIRTIO
    select RT_USING_VIRTIO_INPUT
    default n
    depends on BSP_USING_VIRTIO

endmenu

config BSP_USING_RAMDISK
    bool "RAM disk at physical address 0x0c000000 (64 MiB)"
    depends on RT_USING_DFS && !RT_USING_NANO
    default y
    help
        Load a FAT image with QEMU's generic loader before starting the CPU.
        The upper 64 MiB of guest RAM are reserved for this disk.
```
