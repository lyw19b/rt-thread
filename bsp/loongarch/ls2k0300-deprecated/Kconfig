## bsp/loongarch/ls2k0300/Kconfig
```kconfig
# Copyright (C) 2020-2026 Loongson Technology Corporation Limited
#
# SPDX-License-Identifier: Apache-2.0
#
# Change Logs:
# Date           Author                    Notes
# 2026-10-27     LoongsonLab               standardize file header

# Description:
#   LS2K0300 development BSP Kconfig.

mainmenu "RT-Thread LS2K0300 development board Configuration"
BSP_DIR := .
RTT_DIR := ../../..
PKGS_DIR := packages
config RT_CPUS_NR
    default 1 if RT_USING_SMP
    range 1 1 if RT_USING_SMP

config RT_MMCSD_STACK_SIZE
    default 16384 if BSP_USING_SDIO && RT_USING_SMART

source "$(RTT_DIR)/Kconfig"
osource "$PKGS_DIR/Kconfig"

config BSP_LS2K0300
    bool
    default y
    select ARCH_LOONGARCH64
    select ARCH_LOONGARCH_FPU
    select RT_USING_COMPONENTS_INIT
    select RT_USING_USER_MAIN
    select RT_USING_CACHE
    select ARCH_MM_MMU if RT_USING_SMART
    select ARCH_REMAP_KERNEL if RT_USING_SMART

config __STACKSIZE__
    int "Boot and interrupt stack size"
    default 8192

config BSP_UART_INDEX
    int "Console UART index"
    range 0 9
    default 0
    help
        Uses the firmware pin mux. Match the UART wired to the debug connector.

config BSP_UART_CLOCK_HZ
    int "UART input clock override (0 reads the clock registers)"
    range 0 500000000
    default 0

config BSP_USING_LS2K0300_QEMU
    bool "Standalone ls2k0300 QEMU direct-kernel boot"
    default n
    help
        Select only for the external ls2k0300 machine, not novae_2k0302.
        Its LIOINTC requires the CPU0 route bit. Supply USB clock/reset
        state normally provided by firmware, without changing the emulator.
        This machine has LCD scanout but no Novae accelerator or touch model.
        Physical board defaults and firmware requirements remain unchanged.

config BSP_RAM_END
    hex "End of usable low DDR (physical address)"
    range 0x4000000 0xff00000
    default 0x8000000
    help
        The default uses the first 128 MiB only. Reserve firmware memory by
        lowering this boundary. The DDR controller window at 0x0ff00000 is
        excluded even when firmware leaves it enabled.

config BSP_USING_VANGUARD
    bool "Vanguard Pi physical board wiring"
    depends on !BSP_USING_LS2K0300_QEMU && !BSP_USING_HUMMINGBIRD
    default y if BSP_USING_VANGUARD_TOUCH
    help
        Enable the physical Vanguard reset and USB-A power adapters even
        when building a headless kernel. Display/touch remain optional.
        Existing physical Vanguard touch configurations select this default.

config BSP_USING_VANGUARD_TOUCH
    bool "Vanguard Pi I2C0 GT9147 touch wiring"
    depends on LAXPU_USING_DISPLAY
    default y if BSP_USING_LS2K0300_QEMU
    default n
    help
        Use I2C0 at 0x16108000 with the DTS 200 MHz input clock, address
        0x14, GPIO42 INT and GPIO55 RESET. Configure G48/G49 as I2C0.
        GPIO32..47 share LIOINTC IRQ55, owned here by the touch adapter.
        Preserve the panel's existing 1024x600/falling-edge configuration.
        Enable on physical Vanguard boards; leave off for the legacy
        novae_2k0302 virtual GT911 at 0x5d/IRQ62. A QEMU without a touch
        model will report probe failure, while optional-touch UI can run.

config BSP_USING_HUMMINGBIRD
    bool "Hummingbird LS2K300-MINI-DP physical LCD and I2C1 touch"
    depends on LAXPU_USING_DISPLAY && !BSP_USING_VANGUARD_TOUCH && !BSP_USING_LS2K0300_QEMU
    default n
    help
        Use ls2k300_mini_dp.dts geometry with the tested 45 MHz ATK panel
        clock, GPIO84 backlight,
        I2C1 on GPIO50/51 and GT911/GT9147 INT on GPIO82 (LIOINTC IRQ58).
        This standard SoC board does not contain the project Novae accelerator.

config BSP_USING_SELFTEST
    bool "Build kernel port regression and stress commands"
    default n

source "$(RTT_DIR)/bsp/loongarch/common/gmac/Kconfig"

menuconfig BSP_USING_SDIO
    bool "LS2K0300 SD/eMMC memory hosts (SDIO 1.2)"
    depends on !RT_USING_NANO
    select RT_USING_SDIO
    select RT_USING_MUTEX
    select RT_USING_SEMAPHORE
    default n
    help
        Native memory hosts with bounded DMA and dedicated uncached storage.
        Firmware supplies power. SD cards require 3.3 V; eMMC uses its fixed
        board voltage. Insert cards before boot. Payload writes are disabled
        unless explicitly enabled below.
        SDIO function devices, UHS, eMMC DDR and hot removal are not supported.

if BSP_USING_SDIO
    config BSP_SDIO_DUAL_HOST
        bool "Own SDIO0 eMMC and SDIO1 TF together"
        depends on BSP_USING_VANGUARD
        default y
        help
            Quiesce both owned controller/DMA domains before selecting their
            shared divider. Register mmc0 for eMMC and mmc1 for the TF socket.
            SDR 8-bit eMMC requires the native eMMC boot strap.

    config BSP_SDIO_ALLOW_WRITE
        bool "Allow SD/eMMC payload writes and erase"
        default n
        help
            Leave disabled for board bring-up and read-only validation.
            eMMC partition/OTP programming and cache enable are always blocked.

    config BSP_SDIO_PORT
        int "SDIO controller index"
        range 0 1
        depends on !BSP_SDIO_DUAL_HOST
        default 1 if BSP_USING_VANGUARD
        default 0
        help
            Vanguard Pi connects its TF socket to SDIO1; SDIO0 serves eMMC.

    config BSP_SDIO_ROOT_CLOCK_HZ
        int "DEVICE clock before SDIO division (0 reads PLL registers)"
        range 0 500000000
        default 0
        help
            This is the clock BEFORE the shared SDIO divider at 0x16000420.
            The driver raises the divider if needed for <=400 kHz card setup.
            Single-host mode refuses to disturb a clocked unowned port.
            Dual-host mode rejects card activity, then confirms both owned
            DMA domains are idle before changing their shared clock.

    config BSP_SDIO_MAX_CLOCK_HZ
        int "Maximum SD card clock (Hz)"
        range 400000 25000000
        default 25000000

    config BSP_SDIO_USING_BLOCK_TEST
        bool "Build sdio_block_test read-only block diagnostic"
        depends on RT_USING_FINSH
        default n
        help
            Repeat sequential reads and compare deterministic whole-device
            samples, including the last sectors. Never writes or mounts media.

    config BSP_SDIO_USING_FILE_TEST
        bool "Build sd_filetest filesystem round-trip diagnostic"
        depends on RT_USING_FINSH && RT_USING_POSIX_FS && BSP_SDIO_ALLOW_WRITE
        default n
endif

menuconfig BSP_USING_USB_HOST
    bool "LS2K0300 EHCI high-speed USB host and mass storage"
    default n
    depends on !RT_USING_CHERRYUSB
    select RT_USING_MUTEX
    select RT_USING_SEMAPHORE
    select RT_USING_MESSAGEQUEUE
    select RT_USING_TIMER_SOFT
    select RT_USING_DFS
    select RT_USING_DFS_ELMFAT
    help
        Board-owned EHCI HCD with unchanged CherryUSB core/hub/MSC sources.
        High-speed USB disks may attach directly or through one high-speed hub.
        Firmware must supply the PHY reference clock and release USB reset.
        Physical Vanguard supplies USB-A VBUS through its OTG host port;
        other boards require firmware or fixed board wiring to supply VBUS.
        OHCI low/full-speed devices, OTG and HID are not enabled.
        DMA uses dedicated uncached physical memory in both DMW and PAGE modes.

config BSP_USING_USB_CAMERA
    bool "OpenLANPU UVC camera (Vanguard high-speed USB Host)"
    depends on BSP_USING_USB_HOST && RT_USING_SMART && RT_USING_DFS_V2
    depends on RT_USING_DFS_DEVFS && RT_USING_POSIX_DEVIO && RT_USING_POSIX_POLL
    depends on RT_TICK_PER_SECOND >= 1000
    default n
    help
        Project-owned UVC 1.0/1.1/1.5 MJPEG and YUYV capture via /dev/video0.
        Supports one high-speed isochronous IN (bInterval 1..4) or Bulk IN
        stream. Uses bounded, permanent uncached DMA and copied frame rings.
        USB Host initialization must supply the board PHY and VBUS.

source "$(RTT_DIR)/../../driver/rtos/Kconfig"

source "$(BSP_DIR)/drivers/vnc/Kconfig"

source "$(RTT_DIR)/../../display/systemui/Kconfig"

menu "Imported LS2K0300 peripherals"

config BSP_DEV_GPIO
    bool "LS2K0300 GPIO driver"
    select RT_USING_PIN
    default n

config BSP_DEV_ADC
    bool "LS2K0300 ADC driver"
    select RT_USING_ADC
    select RT_USING_MUTEX
    default n

config BSP_DEV_I2C
    bool "LS2K0300 I2C driver"
    select RT_USING_I2C
    default n
    depends on !BSP_USING_VANGUARD_TOUCH && !BSP_USING_HUMMINGBIRD

config BSP_DEV_PWM
    bool "LS2K0300 PWM driver"
    select RT_USING_PWM
    default n

config BSP_DEV_RTC
    bool "LS2K0300 RTC driver"
    depends on RT_USING_RTC && !RT_USING_SOFT_RTC
    default n

config BSP_DEV_SPI
    bool "LS2K0300 SPI driver"
    select RT_USING_SPI
    select RT_USING_PIN
    default n

config BSP_DEV_THERMAL
    bool "LS2K0300 THERMAL driver"
    select RT_USING_SENSOR
    default n

config BSP_DEV_WDT
    bool "LS2K0300 WDT driver"
    select RT_USING_WDT
    default n

config BSP_DEV_SSD1306
    bool "LS2K0300 SSD1306 driver"
    select RT_USING_I2C
    default n
    depends on BSP_DEV_I2C
    select BSP_USING_I2C1

config BSP_USING_I2C0
    bool "Register I2C0 (firmware must configure its pins)"
    depends on BSP_DEV_I2C
    default n

config BSP_USING_I2C1
    bool "Register I2C1 (firmware must configure its pins)"
    depends on BSP_DEV_I2C
    default n

config BSP_USING_I2C2
    bool "Register I2C2 (firmware must configure its pins)"
    depends on BSP_DEV_I2C
    default n

config BSP_USING_I2C3
    bool "Register I2C3 (firmware must configure its pins)"
    depends on BSP_DEV_I2C
    default n

endmenu
```

## bsp/loongarch/ls2k0300/drivers/vnc/Kconfig
```kconfig
# Copyright (C) 2026 OpenLANPU Contributors
# SPDX-License-Identifier: Apache-2.0

menuconfig BSP_USING_VNC
    bool "Headless memory display and VNC server"
    depends on RT_USING_LWIP && RT_USING_SAL && SAL_USING_POSIX
    depends on !LAXPU_USING_DISPLAY && !BSP_USING_HUMMINGBIRD
    select RT_USING_DEVICE
    select RT_USING_DEVICE_OPS
    select RT_USING_MUTEX
    select RT_USING_TOUCH
    select RT_USING_SMALL_MEM
    default n
    help
        Register a memory-backed lcd and mouse, then serve one RFB viewer.
        No physical LCD, touch controller, or accelerator is required.
        Supports Raw true-color updates and left-button pointer input.
        The service has no authentication or encryption: use a trusted LAN.
        At 1024x600, two framebuffers plus two client images need about 9.4 MiB.

if BSP_USING_VNC
config BSP_VNC_NET_HEAP_KIB
    int "Reserved lwIP buffer heap (KiB)"
    range 128 2048
    default 512
    help
        Keep TCP pbuf allocation independent of Smart ELF/page-cache heap
        fragmentation. This is a fixed board-lifetime memory budget.

config BSP_VNC_PROFILE_TCP
    bool "Instrument TCP write/output and heap allocation timing"
    default n
    help
        BSP-local linker wrappers; shared lwIP and kernel sources stay unchanged.
        Print cumulative wall-clock tick counts through vnc_status. Disable for
        normal operation after identifying the transport bottleneck.

config BSP_VNC_PORT
    int "VNC TCP listen port"
    range 1024 65535
    default 5900
endif
```

## bsp/loongarch/ls2k0300/nano_defconfig
```kconfig
CONFIG_RT_USING_NANO=y
CONFIG_RT_NAME_MAX=16
CONFIG_RT_ALIGN_SIZE=16
CONFIG_RT_TICK_PER_SECOND=1000
CONFIG_RT_USING_OVERFLOW_CHECK=y
CONFIG_RT_USING_HOOK=y
CONFIG_RT_USING_TIMER_SOFT=y
CONFIG_RT_TIMER_THREAD_STACK_SIZE=4096
CONFIG_IDLE_THREAD_STACK_SIZE=4096
CONFIG_RT_MAIN_THREAD_STACK_SIZE=8192
CONFIG_RT_USING_SEMAPHORE=y
CONFIG_RT_USING_MUTEX=y
CONFIG_RT_USING_EVENT=y
CONFIG_RT_USING_MAILBOX=y
CONFIG_RT_USING_MESSAGEQUEUE=y
CONFIG_RT_USING_HEAP=y
CONFIG_RT_USING_SMALL_MEM=y
CONFIG_RT_USING_SMALL_MEM_AS_HEAP=y
CONFIG_RT_USING_CONSOLE=y
CONFIG_RT_CONSOLEBUF_SIZE=256
CONFIG_RT_USING_MSH=y
CONFIG_FINSH_THREAD_STACK_SIZE=8192
CONFIG___STACKSIZE__=8192
CONFIG_BSP_USING_SELFTEST=y
```

## bsp/loongarch/ls2k0300/sd_network_defconfig
```kconfig
CONFIG_RT_NAME_MAX=16
CONFIG_RT_ALIGN_SIZE=16
CONFIG_RT_THREAD_PRIORITY_32=y
CONFIG_RT_TICK_PER_SECOND=1000
CONFIG_RT_USING_OVERFLOW_CHECK=y
CONFIG_RT_USING_HOOK=y
CONFIG_RT_USING_TIMER_SOFT=y
CONFIG_RT_TIMER_THREAD_STACK_SIZE=4096
CONFIG_IDLE_THREAD_STACK_SIZE=4096
CONFIG_RT_MAIN_THREAD_STACK_SIZE=8192
CONFIG_RT_USING_SEMAPHORE=y
CONFIG_RT_USING_MUTEX=y
CONFIG_RT_USING_EVENT=y
CONFIG_RT_USING_MAILBOX=y
CONFIG_RT_USING_MESSAGEQUEUE=y
CONFIG_RT_USING_HEAP=y
CONFIG_RT_USING_SMALL_MEM=y
CONFIG_RT_USING_SMALL_MEM_AS_HEAP=y
CONFIG_RT_USING_CONSOLE=y
CONFIG_RT_CONSOLEBUF_SIZE=256
CONFIG_RT_CONSOLE_DEVICE_NAME="uart"
CONFIG_RT_USING_FINSH=y
CONFIG_FINSH_THREAD_STACK_SIZE=8192
CONFIG_FINSH_USING_MSH=y
CONFIG_FINSH_USING_MSH_DEFAULT=y
CONFIG_FINSH_USING_SYMTAB=y
CONFIG_RT_USING_DEVICE=y
CONFIG_RT_USING_DEVICE_OPS=y
CONFIG_RT_USING_SERIAL=y
CONFIG_RT_USING_SERIAL_V1=y
CONFIG_RT_USING_PIN=n
CONFIG_RT_USING_LIBC=y
CONFIG_RT_USING_POSIX_FS=y
CONFIG_RT_USING_DFS=y
CONFIG_RT_USING_DFS_V2=y
CONFIG_RT_USING_DFS_ELMFAT=y
CONFIG_RT_DFS_ELM_REENTRANT=y
CONFIG_RT_USING_DFS_DEVFS=y
CONFIG___STACKSIZE__=8192
CONFIG_RT_USING_SMART=y
CONFIG_LOONGARCH_SOFTWARE_PTW=y
CONFIG_RT_USING_LWP_MEM_CONTIGUOUS=n
CONFIG_RT_USING_RTC=y
CONFIG_RT_USING_SOFT_RTC=y
CONFIG_RT_USING_MMU=y
CONFIG_KERNEL_VADDR_START=0xffffffc000000000
CONFIG_RT_USING_DFS_TMPFS=y
CONFIG_BSP_USING_SELFTEST=y

CONFIG_RT_USING_SMP=y
CONFIG_RT_CPUS_NR=1

# Native SDIO0 and GMAC0 for the project 2K0300/2K0302 board.
# Requires firmware card power, PHY reset and RGMII delay configuration.
CONFIG_BSP_USING_SDIO=y
CONFIG_BSP_SDIO_PORT=0
CONFIG_RT_MMCSD_STACK_SIZE=4096
CONFIG_RT_SDIO_STACK_SIZE=4096
CONFIG_BSP_SDIO_USING_FILE_TEST=y
CONFIG_RT_USING_LWIP=y
CONFIG_RT_USING_LWIP212=y
CONFIG_RT_LWIP_DHCP=y
CONFIG_RT_LWIP_USING_PING=y
CONFIG_RT_LWIP_TCPTHREAD_STACKSIZE=4096
CONFIG_RT_LWIP_ETHTHREAD_STACKSIZE=4096
CONFIG_RT_USING_NETDEV=y
CONFIG_RT_USING_SAL=y
CONFIG_SAL_USING_POSIX=y
CONFIG_BSP_USING_GMAC=y
CONFIG_BSP_USING_GMAC0=y
# CONFIG_BSP_USING_GMAC1 is not set
CONFIG_BSP_GMAC_USING_ECHO_TEST=y
```
